VERSION ""

NS_ :

BS_:

BU_: ECU Dashboard

BO_ 256 EngineData: 4 ECU
 SG_ EngineRPM : 0|16@1+ (1,0) [0|8000] "rpm"  Dashboard
 SG_ EngineTemp : 16|8@1+ (1,-40) [-40|215] "degC"  Dashboard

BO_ 512 VehicleSpeed: 3 ECU
 SG_ Speed : 0|16@1+ (1,0) [0|65535] "km/h"  Dashboard
 SG_ Gear : 16|8@1+ (1,0) [0|0] ""  Dashboard

CM_ BO_ 256 "엔진 데이터: 회전수와 냉각수 온도";
CM_ SG_ 256 EngineRPM "엔진 회전수";
CM_ SG_ 256 EngineTemp "엔진 냉각수 온도";
CM_ BO_ 512 "차량 속도와 기어 단수";
CM_ SG_ 512 Speed "차량 속도";
CM_ SG_ 512 Gear "기어 단수(범위·단위 미지정 신호 예시)";
